## drivers/input/fingerprint/Kconfig
```kconfig
menuconfig INPUT_FINGERPRINT
	bool "Fingerprint"
	help
	  Say Y here, and a list of supported fingerprint will be displayed.
	  This option doesn't affect the kernel.

	  If unsure, say Y.

#source "goodixfp/Kconfig"
config FINGERPRINT_GOODIX
	tristate "generic goodix fingerprint driver"
	help
	add support for goodix fingerprint driver.
```

## drivers/input/touchscreen/focaltech_lenovo/Kconfig
```kconfig
#
# Focaltech Touchscreen driver configuration
#

config TOUCHSCREEN_FTS_LENOVO
        bool "Focaltech Touchscreen"
		depends on I2C
		default n
		help
		  Say Y here if you have Focaltech touch panel.
		  If unsure, say N.

config TOUCHSCREEN_FTS_LENOVO_DIRECTORY
    string "Focaltech ts directory name"
    default "focaltech_lenovo"
    depends on TOUCHSCREEN_FTS_LENOVO
    
```

## drivers/platform/lenovo/Kconfig
```kconfig
# Lenovo configuration options

menu "Lenovo board selection"

config PRODUCT_HEART
	bool "Lenovo heart board"
	help
		Support for Lenovo Z5 Pro GT

config PRODUCT_ZIPPO
	bool "Lenovo zippo board"
	help
		Support for Lenovo Z6 Pro

endmenu
```

## techpack/audio/Kconfig
```kconfig
config SND_SOC_TFA9874
	tristate "SND_SOC_TFA9874"
config SND_SOC_CS35L41
	tristate "SND_SOC_CS35L41"
config SND_SOC_CS35L41_I2C
	tristate "CONFIG_SND_SOC_CS35L41_I2C"
config SND_SOC_CS35L41_SPI
	tristate "SND_SOC_CS35L41_SPI"
config SND_SOC_CS47L35
	tristate "SND_SOC_CS47L35"
config SND_SOC_MADERA
	tristate "SND_SOC_MADERA"

source "techpack/audio/asoc/Kconfig"
```
