/* Copyright (c) 2018, The Linux Foundation. All rights reserved.
 *
 * This program is free software; you can redistribute it and/or modify
 * it under the terms of the GNU General Public License version 2 and
 * only version 2 as published by the Free Software Foundation.
 *
 * This program is distributed in the hope that it will be useful,
 * but WITHOUT ANY WARRANTY; without even the implied warranty of
 * MERCHANTABILITY or FITNESS FOR A PARTICULAR PURPOSE.  See the
 * GNU General Public License for more details.
 */

/dts-v1/;

#include "sm8150-v2.dtsi"

/ {
	model = "Qualcomm Technologies, Inc. SM8150 v2 SoC";
	compatible = "qcom,sm8150";
	qcom,pmic-name = "PM8150";
	qcom,board-id = <0 0>;
};

//Overlay files made from Lenovo OSS kernel

#include "lenovo-sm8150/common/sm8150.dtsi"
#include "lenovo-sm8150/common/sm8150-pinctrl.dtsi"
#include "lenovo-sm8150/heart/sm8150-pinctrl.dtsi"
#include "lenovo-sm8150/heart/lenovo-heart-pinctrl.dtsi"
#include "lenovo-sm8150/common/sm8150-regulator.dtsi"
#include "lenovo-sm8150/heart/sm8150-audio.dtsi"
#include "lenovo-sm8150/common/msm-audio-lpass.dtsi"
#include "lenovo-sm8150/common/sm8150-thermal.dtsi"
#include "lenovo-sm8150/common/sm8150-usb.dtsi"
#include "lenovo-sm8150/heart/sm8150-pinctrl.dtsi"

//#include "lenovo-heart-sm8150-mtp-overlay.dts"