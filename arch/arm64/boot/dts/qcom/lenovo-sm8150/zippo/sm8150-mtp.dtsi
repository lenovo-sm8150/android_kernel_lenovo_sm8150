&qupv3_se11_i2c {
        status = "ok";
        tfa9874_i2c@34 {
                compatible = "nxp,tfa9874";
                reg = <0x34>;
                status = "ok";
                reset-gpio = <&tlmm 98 0x0>;
                irq-gpio = <&tlmm 101 0x2008>;
                tfa9874-supply = <&pm8150l_l8>;
        };
};


&pm8150b_charger {
	qcom,sec-charger-config = <1>;
};